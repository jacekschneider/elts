## build/conf/bblayers.conf
```bitbake
# POKY_BBLAYERS_CONF_VERSION is increased each time build/conf/bblayers.conf
# changes incompatibly
POKY_BBLAYERS_CONF_VERSION = "2"

BBPATH = "${TOPDIR}"
BBFILES ?= ""

BBLAYERS ?= " \
  /home/jschneider/projects/elts/poky/meta \
  /home/jschneider/projects/elts/poky/meta-poky \
  /home/jschneider/projects/elts/poky/meta-yocto-bsp \
  /home/jschneider/projects/elts/layers/meta-openembedded/meta-oe \
  /home/jschneider/projects/elts/layers/meta-openembedded/meta-python \
  /home/jschneider/projects/elts/layers/meta-openembedded/meta-networking \
  /home/jschneider/projects/elts/layers/meta-raspberrypi \
  /home/jschneider/projects/elts/layers/meta-elts \
  /home/jschneider/projects/elts/layers/meta-openembedded/meta-multimedia \
  "
```

## build/conf/local.conf
```bitbake
MACHINE = "rpi4-elts"
#MACHINE = "zynq-generic"

DISTRO ?= "poky"
EXTRA_IMAGE_FEATURES ?= "allow-empty-password empty-root-password allow-root-login"
```
